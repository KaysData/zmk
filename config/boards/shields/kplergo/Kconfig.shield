## config/boards/shields/kplergo/Kconfig.shield
```kconfig
config SHIELD_KPLERGO_LEFT
    def_bool $(shields_list_contains,kplergo_left)

config SHIELD_KPLERGO_RIGHT
    def_bool $(shields_list_contains,kplergo_right)
```
